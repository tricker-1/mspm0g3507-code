/**
 * @cliArgs --device "MSPM0G350X" --package "LQFP-64(PM)" --part "Default" --product "mspm0_sdk@2.01.00.03"
 * @versions {"tool":"1.19.0+3426"}
 */

/**
 * Import the modules used in this configuration.
 */
const Board    = scripting.addModule("/ti/driverlib/Board");
const CAPTURE  = scripting.addModule("/ti/driverlib/CAPTURE", {}, false);
const CAPTURE1 = CAPTURE.addInstance();
const COMP     = scripting.addModule("/ti/driverlib/COMP", {}, false);
const COMP1    = COMP.addInstance();
const SYSCTL   = scripting.addModule("/ti/driverlib/SYSCTL");
const VREF     = scripting.addModule("/ti/driverlib/VREF");

/**
 * Write custom configuration values to the imported modules.
 */
Board.InitPriority8   = "/ti/driverlib/VREF";
Board.configureUnused = true;

CAPTURE1.$name              = "CAPTURE_0";
CAPTURE1.timerClkSrc        = "LFCLK";
CAPTURE1.timerClkDiv        = 2;
CAPTURE1.timerPeriod        = "2s";
CAPTURE1.captSelect         = "Trigger";
CAPTURE1.subscriberPort     = "FSUB0";
CAPTURE1.subscriberChannel  = 1;
CAPTURE1.interrupts         = ["CC0_DN","ZERO"];
CAPTURE1.peripheral.$assign = "TIMG0";

COMP1.selectOutputFilter                    = "DL_COMP_FILTER_DELAY_1200";
COMP1.compMode                              = "DL_COMP_MODE_ULP";
COMP1.hysteresis                            = "DL_COMP_HYSTERESIS_30";
COMP1.vSource                               = "DL_COMP_REF_SOURCE_VDDA_DAC";
COMP1.controlSelect                         = "DL_COMP_DAC_CONTROL_SW";
COMP1.pubChanID                             = 1;
COMP1.enabledEvents                         = ["DL_COMP_EVENT_OUTPUT_EDGE"];
COMP1.channelEnable                         = ["NEG"];
COMP1.$name                                 = "COMP";
COMP1.peripheral.$assign                    = "COMP0";
COMP1.peripheral.compPinNeg0.$assign        = "PA27";
COMP1.compPinNeg0Config.$name               = "ti_driverlib_gpio_GPIOPinGeneric0";
COMP1.compPinNeg0Config.hideOutputInversion = scripting.forceWrite(false);

SYSCTL.powerPolicy           = "STOP0";
SYSCTL.forceDefaultClkConfig = true;
SYSCTL.clockTreeEn           = true;

VREF.vrefPosPinConfig.$name = "ti_driverlib_gpio_GPIOPinGeneric1";

/**
 * Pinmux solution for unlocked pins/peripherals. This ensures that minor changes to the automatic solver in a future
 * version of the tool will not impact the pinmux you originally saw.  These lines can be completely deleted in order to
 * re-solve from scratch.
 */
Board.peripheral.$suggestSolution           = "DEBUGSS";
Board.peripheral.swclkPin.$suggestSolution  = "PA20";
Board.peripheral.swdioPin.$suggestSolution  = "PA19";
VREF.peripheral.$suggestSolution            = "VREF";
VREF.peripheral.vrefPosPin.$suggestSolution = "PA23";
