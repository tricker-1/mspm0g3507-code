/**
 * @cliArgs --device "MSPM0G350X" --package "LQFP-64(PM)" --part "Default" --product "mspm0_sdk@2.01.00.03"
 * @versions {"tool":"1.20.0+3587"}
 */

/**
 * Import the modules used in this configuration.
 */
const Board  = scripting.addModule("/ti/driverlib/Board");
const COMP   = scripting.addModule("/ti/driverlib/COMP", {}, false);
const COMP1  = COMP.addInstance();
const GPIO   = scripting.addModule("/ti/driverlib/GPIO", {}, false);
const GPIO1  = GPIO.addInstance();
const GPIO2  = GPIO.addInstance();
const OPA    = scripting.addModule("/ti/driverlib/OPA", {}, false);
const OPA1   = OPA.addInstance();
const SYSCTL = scripting.addModule("/ti/driverlib/SYSCTL");

/**
 * Write custom configuration values to the imported modules.
 */
const divider7       = system.clockTree["PLL_PDIV"];
divider7.divideValue = 2;

const divider9       = system.clockTree["UDIV"];
divider9.divideValue = 2;

const multiplier2         = system.clockTree["PLL_QDIV"];
multiplier2.multiplyValue = 5;

const mux8       = system.clockTree["HSCLKMUX"];
mux8.inputSelect = "HSCLKMUX_SYSPLL2X";


COMP1.$name                         = "COMP_0";
COMP1.terminalSelect                = "DL_COMP_REF_TERMINAL_SELECT_NEG";
COMP1.enabledInterrupts             = ["DL_COMP_INTERRUPT_OUTPUT_READY"];
COMP1.controlSelect                 = "DL_COMP_DAC_CONTROL_SW";
COMP1.hysteresis                    = "DL_COMP_HYSTERESIS_20";
COMP1.setDACCode0                   = 0x4D;
COMP1.vSource                       = "DL_COMP_REF_SOURCE_VDDA_DAC";
COMP1.outputEnable                  = true;
COMP1.peripheral.compPinOut.$assign = "PA7";
COMP1.compPinOutConfig.$name        = "ti_driverlib_gpio_GPIOPinGeneric0";

GPIO1.$name                          = "GPIO_OLED";
GPIO1.associatedPins.create(2);
GPIO1.associatedPins[0].$name        = "PIN_SCL";
GPIO1.associatedPins[0].assignedPort = "PORTB";
GPIO1.associatedPins[0].assignedPin  = "3";
GPIO1.associatedPins[1].$name        = "PIN_SDA";
GPIO1.associatedPins[1].assignedPort = "PORTB";
GPIO1.associatedPins[1].assignedPin  = "2";

GPIO2.$name                              = "GPIO_Key";
GPIO2.associatedPins.create(4);
GPIO2.associatedPins[0].$name            = "GPIO_K3";
GPIO2.associatedPins[0].direction        = "INPUT";
GPIO2.associatedPins[0].assignedPort     = "PORTB";
GPIO2.associatedPins[0].assignedPin      = "9";
GPIO2.associatedPins[0].ioStructure      = "SD";
GPIO2.associatedPins[1].$name            = "GPIO_K4";
GPIO2.associatedPins[1].direction        = "INPUT";
GPIO2.associatedPins[1].internalResistor = "PULL_UP";
GPIO2.associatedPins[1].assignedPort     = "PORTA";
GPIO2.associatedPins[1].assignedPin      = "27";
GPIO2.associatedPins[1].ioStructure      = "SD";
GPIO2.associatedPins[2].$name            = "GPIO_K1";
GPIO2.associatedPins[2].direction        = "INPUT";
GPIO2.associatedPins[2].internalResistor = "PULL_UP";
GPIO2.associatedPins[2].assignedPort     = "PORTA";
GPIO2.associatedPins[2].assignedPin      = "26";
GPIO2.associatedPins[3].$name            = "GPIO_K2";
GPIO2.associatedPins[3].direction        = "INPUT";
GPIO2.associatedPins[3].assignedPort     = "PORTB";
GPIO2.associatedPins[3].internalResistor = "PULL_UP";
GPIO2.associatedPins[3].assignedPin      = "24";

OPA1.$name              = "OPA_0";
OPA1.advBW              = "HIGH";
OPA1.cfg0PSELChannel    = "DAC8_OUT";
OPA1.cfg0OutputPin      = "ENABLED";
OPA1.cfg0NSELChannel    = "RTOP";
OPA1.cfg0Chop           = "STANDARD";
OPA1.OutPinConfig.$name = "ti_driverlib_gpio_GPIOPinGeneric1";

SYSCTL.forceDefaultClkConfig = true;
SYSCTL.clockTreeEn           = true;

/**
 * Pinmux solution for unlocked pins/peripherals. This ensures that minor changes to the automatic solver in a future
 * version of the tool will not impact the pinmux you originally saw.  These lines can be completely deleted in order to
 * re-solve from scratch.
 */
Board.peripheral.$suggestSolution            = "DEBUGSS";
Board.peripheral.swclkPin.$suggestSolution   = "PA20";
Board.peripheral.swdioPin.$suggestSolution   = "PA19";
COMP1.peripheral.$suggestSolution            = "COMP0";
GPIO1.associatedPins[0].pin.$suggestSolution = "PB3";
GPIO1.associatedPins[1].pin.$suggestSolution = "PB2";
GPIO2.associatedPins[0].pin.$suggestSolution = "PB9";
GPIO2.associatedPins[1].pin.$suggestSolution = "PA27";
GPIO2.associatedPins[2].pin.$suggestSolution = "PA26";
GPIO2.associatedPins[3].pin.$suggestSolution = "PB24";
OPA1.peripheral.$suggestSolution             = "OPA0";
OPA1.peripheral.OutPin.$suggestSolution      = "PA22";
