/**
 * @cliArgs --device "MSPM0G350X" --package "LQFP-64(PM)" --part "Default" --product "mspm0_sdk@2.01.00.03"
 * @versions {"tool":"1.20.0+3587"}
 */

/**
 * Import the modules used in this configuration.
 */
const ADC12         = scripting.addModule("/ti/driverlib/ADC12", {}, false);
const ADC121        = ADC12.addInstance();
const GPIO          = scripting.addModule("/ti/driverlib/GPIO", {}, false);
const GPIO1         = GPIO.addInstance();
const SYSCTL        = scripting.addModule("/ti/driverlib/SYSCTL");
const TIMER         = scripting.addModule("/ti/driverlib/TIMER", {}, false);
const TIMER1        = TIMER.addInstance();
const ProjectConfig = scripting.addModule("/ti/project_config/ProjectConfig");

/**
 * Write custom configuration values to the imported modules.
 */
const divider7       = system.clockTree["PLL_PDIV"];
divider7.divideValue = 2;

const divider9       = system.clockTree["UDIV"];
divider9.divideValue = 2;

const multiplier2         = system.clockTree["PLL_QDIV"];
multiplier2.multiplyValue = 5;

const mux8       = system.clockTree["HSCLKMUX"];
mux8.inputSelect = "HSCLKMUX_SYSPLL2X";

ADC121.$name                   = "ADC12_0";
ADC121.sampClkSrc              = "DL_ADC12_CLOCK_ULPCLK";
ADC121.powerDownMode           = "DL_ADC12_POWER_DOWN_MODE_MANUAL";
ADC121.enabledInterrupts       = ["DL_ADC12_INTERRUPT_DMA_DONE"];
ADC121.configureDMA            = true;
ADC121.sampCnt                 = 1;
ADC121.enabledDMATriggers      = ["DL_ADC12_DMA_MEM0_RESULT_LOADED"];
ADC121.adcMem0chansel          = "DL_ADC12_INPUT_CHAN_2";
ADC121.sampleTime0             = "25ns";
ADC121.sampleTime1             = "25 ns";
ADC121.DMA_CHANNEL.$name       = "DMA_CH0";
ADC121.DMA_CHANNEL.srcLength   = "HALF_WORD";
ADC121.DMA_CHANNEL.dstLength   = "HALF_WORD";
ADC121.DMA_CHANNEL.addressMode = "f2b";
ADC121.adcPin2Config.$name     = "ti_driverlib_gpio_GPIOPinGeneric0";

const Board = scripting.addModule("/ti/driverlib/Board", {}, false);

GPIO1.$name                          = "GPIO_OLED";
GPIO1.associatedPins.create(2);
GPIO1.associatedPins[0].$name        = "PIN_SCL";
GPIO1.associatedPins[0].assignedPort = "PORTB";
GPIO1.associatedPins[0].assignedPin  = "2";
GPIO1.associatedPins[1].$name        = "PIN_SDA";
GPIO1.associatedPins[1].assignedPort = "PORTB";
GPIO1.associatedPins[1].assignedPin  = "3";

SYSCTL.forceDefaultClkConfig = true;
SYSCTL.clockTreeEn           = true;

TIMER1.$name       = "TIMER_0";
TIMER1.timerMode   = "PERIODIC";
TIMER1.interrupts  = ["ZERO"];
TIMER1.timerPeriod = "2us";

ProjectConfig.genLibCMSIS = true;

/**
 * Pinmux solution for unlocked pins/peripherals. This ensures that minor changes to the automatic solver in a future
 * version of the tool will not impact the pinmux you originally saw.  These lines can be completely deleted in order to
 * re-solve from scratch.
 */
ADC121.peripheral.$suggestSolution             = "ADC1";
ADC121.peripheral.adcPin2.$suggestSolution     = "PA17";
ADC121.DMA_CHANNEL.peripheral.$suggestSolution = "DMA_CH0";
Board.peripheral.$suggestSolution              = "DEBUGSS";
Board.peripheral.swclkPin.$suggestSolution     = "PA20";
Board.peripheral.swdioPin.$suggestSolution     = "PA19";
GPIO1.associatedPins[0].pin.$suggestSolution   = "PB2";
GPIO1.associatedPins[1].pin.$suggestSolution   = "PB3";
TIMER1.peripheral.$suggestSolution             = "TIMA0";
